## config/boards/shields/mamekey_S/Kconfig.shield
```kconfig
# No whitespace after the comma or in your keyboard name!
config SHIELD_MAMEKEYS_R
        def_bool $(shields_list_contains,mamekeyS_R)
        
config SHIELD_MAMEKEYS_L
        def_bool $(shields_list_contains,mamekeyS_L)
```

## config/west.yml
```yaml
manifest:
  remotes:
    - name: zmkfirmware
      url-base: https://github.com/zmkfirmware
    - name: badjeff    # <-- PMW3610
      url-base: https://github.com/badjeff
    - name: mameeeeekko
      url-base: https://github.com/mameeeeekko
    - name: caksoylar
      url-base: https://github.com/caksoylar
    - name: prospector
      url-base: https://github.com/t-ogura

  projects:
    - name: zmk
      remote: zmkfirmware
      revision: main
      import: app/west.yml
    - name: zmk-pmw3610-driver
      remote: badjeff
      revision: main
    - name: zmk-rgbled-widget
      remote: caksoylar
      revision: main
    - name: prospector-zmk-module
      remote: prospector
      #revision: main
      revision: feature/zephyr-4.1-lvgl9-container-fix
      path: modules/prospector-zmk-module

  self:
    path: config
```
